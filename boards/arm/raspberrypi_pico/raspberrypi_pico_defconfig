## boards/arm/raspberrypi_pico/raspberrypi_pico_defconfig
```kconfig
CONFIG_SOC_SERIES_RP2XXX=y
CONFIG_SOC_RP2040=y
CONFIG_SYS_CLOCK_HW_CYCLES_PER_SEC=125000000
```

## boards/arm/seeeduino_xiao_ble_nrf52840/Kconfig
```kconfig
# Seeeduino Xiao BLE nRF52840 board configuration

# Copyright (c) 2021 Peter Johanson
# SPDX-License-Identifier: Apache-2.0

config BOARD_ENABLE_DCDC
	bool "Enable DCDC mode"
	select SOC_DCDC_NRF52X
	default y
	depends on BOARD_SEEEDUINO_XIAO_BLE_NRF52840 || BOARD_SEEEDUINO_XIAO_BLE_NRF52840_SENSE
```

## boards/arm/seeeduino_xiao_ble_nrf52840/Kconfig.board
```kconfig
# Seeeduino Xiao BLE nRF52840 board configuration

# Copyright (c) 2021 Peter Johanson
# SPDX-License-Identifier: Apache-2.0

config BOARD_SEEEDUINO_XIAO_BLE_NRF52840
	bool "Seeeduino Xiao BLE nRF52840"
	depends on SOC_NRF52840_QIAA

config BOARD_SEEEDUINO_XIAO_BLE_NRF52840_SENSE
	bool "Seeeduino Xiao BLE nRF52840 Sense"
	depends on SOC_NRF52840_QIAA
```

## boards/arm/seeeduino_xiao_ble_nrf52840/Kconfig.defconfig
```kconfig
# Seeeduino Xiao BLE nRF52840 board configuration

# Copyright (c) 2021 Peter Johanson
# SPDX-License-Identifier: Apache-2.0

config BOARD
	default "seeeduino_xiao_ble_nrf52840" if BOARD_SEEEDUINO_XIAO_BLE_NRF52840
	default "seeeduino_xiao_ble_nrf52840_sense" if BOARD_SEEEDUINO_XIAO_BLE_NRF52840_SENSE

if BOARD_SEEEDUINO_XIAO_BLE_NRF52840 || BOARD_SEEEDUINO_XIAO_BLE_NRF52840_SENSE

config BT_CTLR
	default BT

endif # BOARD_SEEEDUINO_XIAO_BLE_NRF52840 || BOARD_SEEEDUINO_XIAO_BLE_NRF52840_SENSE
```

## drivers/display/Kconfig.il0323
```kconfig
# IL0323 display controller configuration options

# Copyright (c) 2020 Phytec Messtechnik GmbH, Peter Johanson
# SPDX-License-Identifier: Apache-2.0

config IL0323
	bool "IL0323 compatible display controller driver"
	depends on SPI
	depends on HEAP_MEM_POOL_SIZE != 0
	help
	  Enable driver for IL0323 compatible controller.
```

## drivers/gpio/Kconfig.rpi_pico
```kconfig
# Copyright (c) 2021 Yonatan Schachter
# SPDX-License-Identifier: Apache-2.0

config GPIO_RPI_PICO
	bool "Raspberry Pi Pico GPIO driver"
```

## drivers/kscan/Kconfig.gpio
```kconfig
# Generic GPIO Keyboard Matrix

# Copyright (c) 2020 Peter Johanson <peter@peterjohanson.com>
# SPDX-License-Identifier: Apache-2.0

menuconfig KSCAN_GPIO
	bool "GPIO Keyboard Matrix KSCAN driver"
	depends on GPIO && HAS_DTS_GPIO
	help
	  Enable the generic GPIO keyboard matrix driver.

if KSCAN_GPIO

config KSCAN_GPIO_POLL_PERIOD
	int "KSCAN_GPIO_POLL_PERIOD"
	default 5
	help
	  Defines the poll period in msecs between between matrix scans.

endif # KSCAN_GPIO
```

## drivers/pinctrl/Kconfig.rpi_pico
```kconfig
# Copyright (c) 2021 Yonatan Schachter
# SPDX-License-Identifier: Apache-2.0

DT_COMPAT_RPI_PICO_PINCTRL := raspberrypi,pico-pinctrl

config PINCTRL_RASPBERRYPI_PICO
	bool "RaspberryPi Pico pin controller driver"
	depends on SOC_FAMILY_RASPBERRY_PI
	default $(dt_compat_enabled,$(DT_COMPAT_RPI_PICO_PINCTRL))
	help
		RaspberryPi Pico pinctrl driver
```

## drivers/sensor/pim447/Kconfig
```kconfig
# PIM447 Pimonori Trackball Breakout

# Copyright (c) 2020 Peter Johanson
# SPDX-License-Identifier: Apache-2.0

menuconfig PIM447
	bool "PIM447 Pimonori Trackball Breakout"
	depends on I2C
	help
	  Enable driver for PIM447 trackball and RGB LED

if PIM447

choice
	prompt "Trigger mode"
	default PIM447_TRIGGER_NONE
	help
	  Specify the type of triggering to be used by the driver.

config PIM447_TRIGGER_NONE
	bool "No trigger"

config PIM447_TRIGGER_GLOBAL_THREAD
	bool "Use global thread"
	depends on GPIO
	select PIM447_TRIGGER

config PIM447_TRIGGER_OWN_THREAD
	bool "Use own thread"
	depends on GPIO
	select PIM447_TRIGGER

endchoice

config PIM447_TRIGGER
	bool

config PIM447_THREAD_PRIORITY
	int "Thread priority"
	depends on PIM447_TRIGGER_OWN_THREAD
	default 10
	help
	  Priority of thread used by the driver to handle interrupts.

config PIM447_THREAD_STACK_SIZE
	int "Thread stack size"
	depends on PIM447_TRIGGER_OWN_THREAD
	default 1024
	help
	  Stack size of thread used by the driver to handle interrupts.

choice
	prompt "Measurements per second"
	default PIM447_MPS_1
	depends on PIM447_PERIODIC_MODE
	help
	  Number of measurements per second.

config PIM447_MPS_05
	bool "0.5"

config PIM447_MPS_1
	bool "1"

config PIM447_MPS_2
	bool "2"

config PIM447_MPS_4
	bool "4"

config PIM447_MPS_10
	bool "10"

endchoice

endif # PIM447
```

## drivers/serial/Kconfig.rpi_pico
```kconfig
# Copyright (c) 2021 Yonatan Schachter
# SPDX-License-Identifier: Apache-2.0

config UART_RPI_PICO
	bool "Raspberry Pi UART driver"
	select SERIAL_HAS_DRIVER
```

## drivers/spi/Kconfig.rpi_pico
```kconfig
# RaspberryPi Pico SPI

# Copyright (c) 2021 Pete Johanson
# SPDX-License-Identifier: Apache-2.0

# Workaround for not being able to have commas in macro arguments
DT_COMPAT_RPI_PICO_SPI := rpi,pico-spi

config SPI_RPI_PICO
	default $(dt_compat_enabled,$(DT_COMPAT_RPI_PICO_SPI))
	bool "RaspberryPi Pico SPI driver"
	select PICOSDK_USE_SPI
	help
	  Enable support for the RaspberryPi Pico SPI driver.
```

## dts/bindings/kscan/gpio-kscan.yaml
```yaml
# Copyright (c) 2020, Pete Johanson
# SPDX-License-Identifier: Apache-2.0

description: GPIO keyboard matrix controller

compatible: "gpio-kscan"

include: kscan.yaml

properties:
    row-gpios:
        type: phandle-array
        required: true
    col-gpios:
        type: phandle-array
        required: true
    diode-direction:
        type: string
        default: row2col
        enum:
          - row2col
          - col2row
```

## dts/bindings/pinctrl/raspberrypi,pico-pinctrl.yaml
```yaml
# Copyright (c) 2021 Yonatan Schachter
# SPDX-License-Identifier: Apache-2.0

description: |
    RaspberryPi Pico Pin controller Node
    Based on pincfg-node.yaml binding.

compatible: "raspberrypi,pico-pinctrl"

include:
    - name: base.yaml
    - name: pincfg-node-group.yaml
      child-binding:
        child-binding:
          property-allowlist:
            - bias-disable
            - bias-pull-down
            - bias-pull-up
            - input-enable
            - input-schmitt-enable

child-binding:
  description: |
    Definitions for a pinctrl state.
  child-binding:
    properties:
      pinmux:
        required: true
        type: array
        description: |
          An array of pins sharing the same group properties. Each
          element of the array is an integer constructed from the
          pin number and the alternative function of the pin.
      drive-strength:
        required: false
        type: int
        enum:
          - 2
          - 4
          - 8
          - 12
      slew-rate-fast:
        required: false
        type: boolean
```

## dts/bindings/sensor/pimonori,pim447.yaml
```yaml
# Copyright (c) 2020, Peter Johanson
# SPDX-License-Identifier: Apache-2.0

description: Pimonori PIM447 trackball breakout w/ RGB LEDs

compatible: "pimonori,pim447"

include: i2c-device.yaml

properties:
    alert-gpios:
      type: phandle-array
      required: false
      description: >
        ALERT pin.

        This pin signals active high when produced by the sensor.  The
        property value should ensure the flags properly describe the
        signal that is presented to the driver.
```

## dts/bindings/serial/rpi,pico-uart.yaml
```yaml
description: Raspberry Pi Pico UART

compatible: "rpi,pico-uart"

include: [uart-controller.yaml, pinctrl-device.yaml]

properties:
    reg:
      required: true

    interrupts:
      required: true
```

## dts/bindings/spi/rpi,pico-spi.yaml
```yaml
# Copyright (c) 2021 Pete Johanson
# SPDX-License-Identifier: Apache-2.0

description: Raspberry Pi Pico family SPI (SPI master)

compatible: "rpi,pico-spi"

include: [spi-controller.yaml, pinctrl-device.yaml]

properties:
    clock-frequency:
      required: true

    reg:
      required: true

    interrupts:
      required: false
```

## dts/bindings/usb/rpi,pico-usbd.yaml
```yaml
# Copyright (c) 2021, Pete Johanson
# SPDX-License-Identifier: Apache-2.0

description: RP2 USB Controller

compatible: "rpi,pico-usbd"

include: usb-ep.yaml

properties:
    reg:
      required: true

    interrupts:
      required: true
```

## soc/arm/raspberrypi/Kconfig.defconfig
```kconfig
# Raspberry Pi (RP) MCU line

# Copyright (c) 2021 Nordic Semiconductor ASA
# SPDX-License-Identifier: Apache-2.0

if SOC_FAMILY_RASPBERRY_PI

source "soc/arm/raspberrypi/*/Kconfig.defconfig.series"

config PINCTRL
	default y

endif # SOC_FAMILY_RASPBERRY_PI
```

## soc/arm/raspberrypi/rp2/Kconfig.soc
```kconfig
# Raspberry Pi RP2XXX MCU line

# Copyright (c) 2021 Nordic Semiconductor ASA
# Copyright (c) 2021 Yonatan Schachter
# SPDX-License-Identifier: Apache-2.0

choice
	prompt "RP2xxx MCU Selection"
	depends on SOC_SERIES_RP2XXX

config SOC_RP2040
	bool "Raspberry Pi RP2040"

endchoice

config RP2_FLASH_W25Q080
	bool

config RP2_FLASH_GENERIC_03H
	bool

config RP2_FLASH_IS25LP080
	bool

config RP2_FLASH_W25X10CL
	bool
```
